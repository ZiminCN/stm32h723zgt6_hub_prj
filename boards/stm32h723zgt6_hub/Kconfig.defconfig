## boards/stm32h723zgt6_hub/Kconfig.defconfig
```kconfig
# STM32H723ZG Nucleo board configuration

# Copyright (c) 2020 Alexander Kozhinov <ak.alexander.kozhinov@gmail.com>
# SPDX-License-Identifier: Apache-2.0

if BOARD_STM32H723ZGT6_HUB

if NETWORKING

config NET_L2_ETHERNET
	default y

endif # NETWORKING

endif # BOARD_STM32H723ZGT6_HUB
```

## boards/stm32h723zgt6_hub/board.yml
```yaml
board:
  name: stm32h723zgt6_hub
  full_name: Nucleo H723ZG
  vendor: st
  socs:
    - name: stm32h723xx
```
